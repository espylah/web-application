## esp32-device/components/blob_detect/Kconfig
```kconfig
menu "Blob Detection"

config BLOB_THRESHOLD_PCT
    int "Foreground threshold (% of mean brightness)"
    default 65
    range 1 99
    help
        A pixel is treated as foreground (insect) if its brightness is below
        this percentage of the image mean brightness.

        threshold = mean_brightness * BLOB_THRESHOLD_PCT / 100

        Lower values → only very dark pixels detected (fewer false positives,
        may miss faint insects).
        Higher values → more pixels detected (catches faint insects, more noise).

        Scaling relative to mean makes this robust across different exposures:
        a dark image (mean=80) gives threshold=52; a bright image (mean=200)
        gives threshold=130 — both correctly isolate objects that are
        significantly darker than the background.

config BLOB_MIN_W
    int "Minimum blob width (pixels)"
    default 8
    range 1 320
    help
        Blobs narrower than this are discarded as noise.

config BLOB_MIN_H
    int "Minimum blob height (pixels)"
    default 8
    range 1 320
    help
        Blobs shorter than this are discarded as noise.

config BLOB_GAP_ROWS
    int "Vertical gap tolerance (rows)"
    default 4
    range 0 32
    help
        Number of background rows that can appear inside a blob before it is
        split into two separate blobs. Useful for insects with a lighter band
        across their body.

config BLOB_GAP_COLS
    int "Horizontal gap tolerance (pixels)"
    default 8
    range 0 64
    help
        Number of background pixels that can appear between two dark runs on
        the same row before they are treated as separate blobs.

endmenu
```

## esp32-device/components/cnn_inference/Kconfig
```kconfig
menu "CNN Inference"

config CNN_MODEL_PARTITION
    bool "Load model from flash partition instead of rodata"
    default n
    help
        When enabled, the .espdl model is loaded from a dedicated OTA-style
        flash partition labelled "model" rather than being linked as rodata.
        Use this if you want to update the model over-the-air without
        reflashing the entire firmware.

        When disabled (default), the model binary is embedded directly into
        the firmware image via EMBED_FILES and loaded from flash rodata.

endmenu
```

## esp32-device/sdkconfig.defaults
```kconfig
# PSRAM (OPI PSRAM on ESP32-S3-WROOM-1-N8R8)
CONFIG_SPIRAM=y
CONFIG_SPIRAM_MODE_OCT=y
CONFIG_SPIRAM_SPEED_80M=y
# Inference monopolizes CPU0 for several seconds — exclude idle task from WDT
CONFIG_ESP_TASK_WDT_CHECK_IDLE_TASK_CPU0=n

CONFIG_SPIRAM_USE_MALLOC=y
CONFIG_SPIRAM_MALLOC_ALWAYSINTERNAL=16384
CONFIG_SPIRAM_MALLOC_RESERVE_INTERNAL=32768

# FAT Long File Name support (required for model filenames > 8 chars)
CONFIG_FATFS_LFN_HEAP=y

# Custom partition table (3.5MB OTA partitions for ESP-DL binary size)
CONFIG_PARTITION_TABLE_CUSTOM=y
CONFIG_PARTITION_TABLE_CUSTOM_FILENAME="partitions.csv"
CONFIG_PARTITION_TABLE_OFFSET=0x8000


# BLE (Bluedroid + GATT server — required by ble_config component)
CONFIG_BT_ENABLED=y
CONFIG_BT_BLUEDROID_ENABLED=y
CONFIG_BT_CONTROLLER_ENABLED=y
CONFIG_BT_BLE_ENABLED=y
CONFIG_BT_BLE_42_FEATURES_SUPPORTED=y
CONFIG_BT_GATTS_ENABLE=y

# Default to 8MB Flash
CONFIG_ESPTOOLPY_FLASHSIZE_8MB=y

#Do not skip provisioning in prod.
CONFIG_SKIP_PROVISIONING=n

CONFIG_ESP_DEFAULT_CPU_FREQ_MHZ_240=y


CONFIG_CNN_MODEL_PARTITION=y
```
